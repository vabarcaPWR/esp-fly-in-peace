## micro/components/led_indicator/Kconfig
```kconfig
menu "LED indicator"

    config LED_INDICATOR_GPIO
        int "WS2812 data GPIO"
        default 2
        help
            GPIO used to drive the WS2812 data line.

    config LED_INDICATOR_PIXEL_COUNT
        int "WS2812 pixel count"
        range 1 64
        default 1
        help
            Number of WS2812 pixels in the LED strip.

    config LED_INDICATOR_RMT_RESOLUTION_HZ
        int "RMT resolution (Hz)"
        default 10000000
        help
            RMT clock resolution used by the LED driver.

endmenu
```

## micro/components/leds/Kconfig
```kconfig
menu "LED Configuration"

    choice LED_BACKEND
        prompt "LED backend"
        default LED_RGB
        help
            Select the LED driver backend.

        config LED_SINGLE
            bool "Single GPIO LED"
            help
                Standard single-color LED driven by GPIO on/off.
                Used on ESP32-C3 Super Mini boards.

        config LED_RGB
            bool "WS2812 RGB LED"
            help
                Addressable RGB LED (WS2812) driven via RMT peripheral.
                Used on ESP32-C3 Zero boards.

    endchoice

    config LED_RGB_GPIO
        int "RGB LED data GPIO"
        default 8
        depends on LED_RGB
        help
            GPIO pin connected to the WS2812 data line.

endmenu
```

## micro/components/sensor_hal/Kconfig
```kconfig
menu "Sensor driver"

    choice SENSOR_DRIVER
        prompt "Pressure sensor driver"
        default SENSOR_MS5611
        help
            Select the barometric pressure sensor connected to the I2C bus.
            Only one sensor driver is compiled into the binary.

        config SENSOR_MS5611
            bool "MS5611"
            help
                TE Connectivity MS5611 barometric pressure sensor.
                I2C address: 0x77 (CSB low) or 0x76 (CSB high).
                Resolution: 24-bit, accuracy ±1.5 mbar.

        config SENSOR_BMP390
            bool "BMP390"
            help
                Bosch BMP390 barometric pressure sensor.
                I2C address: 0x77 (SDO low) or 0x76 (SDO high).
                Resolution: 24-bit, accuracy ±0.5 hPa. Lower noise than MS5611.
    endchoice

    config SENSOR_I2C_SDA_GPIO
        int "I2C SDA GPIO number"
        default 6
        help
            GPIO number for I2C SDA line connected to the pressure sensor.

    config SENSOR_I2C_SCL_GPIO
        int "I2C SCL GPIO number"
        default 7
        help
            GPIO number for I2C SCL line connected to the pressure sensor.

    config SENSOR_I2C_FREQ_HZ
        int "I2C clock frequency (Hz)"
        default 400000
        help
            I2C master clock frequency in Hz. 400000 = Fast Mode.

    config SENSOR_I2C_ADDR
        hex "Sensor I2C address"
        default 0x77
        help
            I2C address of the pressure sensor.
            MS5611: 0x77 (CSB=GND) or 0x76 (CSB=VCC).
            BMP390: 0x77 (SDO=GND) or 0x76 (SDO=VCC).

endmenu
```

## micro/components/sensors/Kconfig
```kconfig
menu "Sensor driver"

    choice SENSOR_DRIVER
        prompt "Pressure sensor driver"
        default SENSOR_MS5611
        help
            Select the barometric pressure sensor connected to the I2C bus.
            Only one sensor driver is compiled into the binary.

        config SENSOR_MS5611
            bool "MS5611"
            help
                TE Connectivity MS5611 barometric pressure sensor.
                I2C address: 0x77 (CSB low) or 0x76 (CSB high).
                Resolution: 24-bit, accuracy ±1.5 mbar.

        config SENSOR_BMP390
            bool "BMP390"
            help
                Bosch BMP390 barometric pressure sensor.
                I2C address: 0x77 (SDO low) or 0x76 (SDO high).
                Resolution: 24-bit, accuracy ±0.5 hPa. Lower noise than MS5611.
    endchoice

    config SENSOR_I2C_SDA_GPIO
        int "I2C SDA GPIO number"
        default 8
        help
            GPIO number for I2C SDA line connected to the pressure sensor.

    config SENSOR_I2C_SCL_GPIO
        int "I2C SCL GPIO number"
        default 9
        help
            GPIO number for I2C SCL line connected to the pressure sensor.

    config SENSOR_I2C_FREQ_HZ
        int "I2C clock frequency (Hz)"
        default 400000
        help
            I2C master clock frequency in Hz. 400000 = Fast Mode.

    config SENSOR_I2C_ADDR
        hex "Sensor I2C address"
        default 0x77
        help
            I2C address of the pressure sensor.
            MS5611: 0x77 (CSB=GND) or 0x76 (CSB=VCC).
            BMP390: 0x77 (SDO=GND) or 0x76 (SDO=VCC).

    config SENSOR_I2C_INTERNAL_PULLUP
        bool "Enable I2C internal pull-ups"
        default n
        help
            Enable weak internal pull-ups (~45 kOhm) on SDA and SCL lines.
            Disabled by default because external 4.7 kOhm pull-ups are
            recommended for reliable 400 kHz operation and lower power draw.
            Each internal pull-up adds ~73 uA leakage at 3.3 V.

    config SENSOR_I2C_ALLOW_PD
        bool "Allow I2C power domain shutdown in sleep"
        default y
        help
            When enabled, the I2C driver backs up and restores peripheral
            registers around light-sleep, allowing the I2C power domain
            to be completely shut off. Saves significant idle power at
            the cost of a small amount of additional RAM (~100 bytes).

endmenu
```

## micro/components/sound/Kconfig
```kconfig
menu "Sound generator"

    choice SOUND_GENERATOR
        prompt "Sound output backend"
        default SOUND_PIEZO
        help
            Select the sound output backend for vario acoustic feedback.
            Only one backend is compiled into the binary.

        config SOUND_PIEZO
            bool "Piezoelectric buzzer (LEDC PWM)"
            help
                Drives a piezoelectric buzzer via ESP32-C3 LEDC PWM.
                Requires a passive piezo buzzer connected to the configured GPIO pin
                with an appropriate current-limiting resistor (100–220 Ohm).
                Frequency range: 100–4000 Hz. Duty cycle: 0–100%.

        config SOUND_MAX98357
            bool "MAX98357A I2S amplifier + speaker"
            help
                Drives a MAX98357A Class D mono amplifier via I2S.
                Generates sine wave tones for smooth, pleasant audio.
                Requires MAX98357A breakout + small speaker (8 Ohm, 0.5–1W).
                Uses 3 GPIOs for I2S (BCLK, WS, DOUT) + 1 GPIO for SD (shutdown).

        config SOUND_NONE
            bool "None (no sound output)"
            help
                Disables all sound output. No audio code is compiled.
                Use this for silent operation or boards without a buzzer.
    endchoice

    config PIEZO_GPIO
        int "Piezo buzzer GPIO number"
        default 5
        depends on SOUND_PIEZO
        help
            GPIO number connected to the piezoelectric buzzer.
            Default: GPIO 5 (available on ESP32-C3 Super Mini).

    config MAX98357_BCLK_GPIO
        int "I2S BCLK GPIO number"
        default 2
        depends on SOUND_MAX98357
        help
            GPIO for I2S bit clock (BCLK).

    config MAX98357_WS_GPIO
        int "I2S WS (LRCLK) GPIO number"
        default 3
        depends on SOUND_MAX98357
        help
            GPIO for I2S word select (LRCLK).

    config MAX98357_DOUT_GPIO
        int "I2S data out GPIO number"
        default 4
        depends on SOUND_MAX98357
        help
            GPIO for I2S data output (DOUT).

    config MAX98357_SD_GPIO
        int "MAX98357A shutdown GPIO number"
        default 1
        depends on SOUND_MAX98357
        help
            GPIO for MAX98357A shutdown pin (SD).
            LOW = amplifier off, HIGH = amplifier on.

    menu "Tone thresholds"
        depends on !SOUND_NONE

        config TONE_CLIMB_THRESHOLD_CMS
            int "Climb threshold (cm/s)"
            default 15
            range 5 100
            help
                Vario rate in cm/s above which the climb beep activates.
                Values below this (and above the pre-lift threshold) are in the
                pre-lift zone. Default: 15 (0.15 m/s).

        config TONE_PRELIFT_THRESHOLD_CMS
            int "Pre-lift threshold (cm/s)"
            default 5
            range 0 50
            help
                Vario rate in cm/s above which the pre-lift tick activates.
                Values between this and the climb threshold produce a slow tick.
                Must be lower than the climb threshold. Default: 5 (0.05 m/s).

        config TONE_SINK_THRESHOLD_CMS
            int "Sink alarm threshold (cm/s, negative)"
            default -200
            range -1000 -50
            help
                Vario rate in cm/s below which the continuous sink alarm sounds.
                Use negative values. Default: -200 (-2.0 m/s).

        config TONE_VOLUME_PCT
            int "Default volume (%)"
            default 30
            range 5 100
            help
                Default audio volume percentage. Default: 30.

    endmenu

endmenu
```
